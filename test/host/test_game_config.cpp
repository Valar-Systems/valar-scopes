// Host tests for ParseGameConfig — the device's parser, fed the server's own config.
//
// ===========================================================================
// THE INPUT IS THE SERVED CONFIG, NOT A TRANSCRIPTION.
//
// argv[1] is test/fixtures/game-config.json, generated by valar-eam-feed's
// scripts/emit-device-fixture.ts from the deployed /config; its `config` block
// is exactly what the server serves. argv[2] is test/fixtures/
// game-config-v1.config.json, the version-1 block copied from git history: the
// pre-ppm shape, which the device must REFUSE. Every expected value below is
// read out of that same JSON by this test, AND the live values are also named,
// so a regenerated fixture that moves one shows up in a diff (as
// test_game_format.cpp's TheLiveBucket does for the scoring constants).
//
// ArduinoJson comes from .pio/libdeps -- the copy the firmware builds with --
// and argv[3] is platformio.ini's pin. A different version is not this
// firmware's parser, so it is refused (exit 2) rather than tested.
//
// Exit 0 pass, 1 a check failed, 2 the rig could not run the test.
// docs/game-config-parse-test.md.
// ===========================================================================

#include "../../src/eam/GameConfig.h"

#include <cmath>
#include <cstdio>
#include <cstring>
#include <string>

static int g_failures = 0;
static int g_checks = 0;
static const char* g_case = "";

#define CHECK(cond, msg)                                                        \
  do {                                                                          \
    g_checks += 1;                                                              \
    if (!(cond)) {                                                              \
      g_failures += 1;                                                          \
      std::printf("  FAIL %s\n       %s\n       at %s:%d\n", g_case, msg,       \
                  __FILE__, __LINE__);                                          \
    }                                                                           \
  } while (0)

#define CASE(name)                                                              \
  g_case = name;                                                                \
  std::printf("  ---- %s\n", name);

static bool ReadFile(const char* path, std::string& out) {
  FILE* f = std::fopen(path, "rb");
  if (!f) return false;
  char buf[4096];
  size_t n;
  while ((n = std::fread(buf, 1, sizeof(buf), f)) > 0) out.append(buf, n);
  std::fclose(f);
  return !out.empty();
}

/// Loads a fixture file, or reports why it could not (the rig, not the code).
static bool Load(const char* path, JsonDocument& doc) {
  std::string text;
  if (!ReadFile(path, text)) {
    std::printf("  RIG: cannot read %s\n", path);
    return false;
  }
  DeserializationError e = deserializeJson(doc, text.c_str(), text.size());
  if (e) {
    std::printf("  RIG: %s is not JSON (%s)\n", path, e.c_str());
    return false;
  }
  if (!doc["config"].is<JsonObjectConst>()) {
    std::printf("  RIG: %s has no `config` object\n", path);
    return false;
  }
  return true;
}

/// This test's own reading of a class name, from the JSON. Unknown is -1.
static int ClassOf(const char* s) {
  if (!s) return -1;
  if (std::strcmp(s, "nam") == 0) return (int)game::MsgClass::Nam;
  if (std::strcmp(s, "fdm") == 0) return (int)game::MsgClass::Fdm;
  if (std::strcmp(s, "execution") == 0) return (int)game::MsgClass::Execution;
  return -1;
}

static int TierOf(const char* s) {
  if (!s) return -1;
  if (std::strcmp(s, "normal") == 0) return (int)game::Tier::Normal;
  if (std::strcmp(s, "snap") == 0) return (int)game::Tier::Snap;
  return -1;
}

static uint32_t Micros(double seconds) { return (uint32_t)std::lround(seconds * 1e6); }

// ---------------------------------------------------------------------------

/// T1. The served v2 config parses, and every field equals the JSON it came from.
static void ServedConfigParses(JsonObjectConst cfg) {
  CASE("the served v2 config parses, every field equal to the JSON");
  CHECK(cfg["version"].as<int>() == 2, "CONTROL: the fixture is not the version-2 config");

  eam::GameConfig gc;
  CHECK(eam::ParseGameConfig(cfg, gc), "the served config was refused");
  CHECK(gc.valid, "the served config parsed but is not marked valid");

  // epoch and hold
  CHECK(gc.params.epoch == cfg["epoch"].as<uint32_t>(), "epoch differs from the JSON");
  CHECK(gc.params.epoch == 1u, "the served epoch is no longer 1");
  CHECK(gc.hold == cfg["hold"].as<bool>(), "hold differs from the JSON");
  CHECK(!gc.hold, "the served config is on HOLD");

  // decode.weights, in served order
  JsonArrayConst w = cfg["decode"]["weights"].as<JsonArrayConst>();
  CHECK(gc.params.n_weights == w.size(), "the weight count differs from the JSON");
  CHECK(gc.params.n_weights == 3u, "the served config no longer has three weights");
  for (size_t i = 0; i < w.size() && i < gc.params.n_weights; i += 1) {
    CHECK((int)gc.params.weights[i].cls == ClassOf(w[i]["class"].as<const char*>()),
          "a weight's class differs from the JSON, or its served order changed");
    CHECK(gc.params.weights[i].ppm == w[i]["ppm"].as<uint32_t>(), "a weight's ppm differs from the JSON");
  }
  static const game::MsgClass kCls[3] = {game::MsgClass::Nam, game::MsgClass::Fdm, game::MsgClass::Execution};
  static const uint32_t kPpm[3] = {830000u, 120000u, 50000u};
  for (size_t i = 0; i < 3 && i < gc.params.n_weights; i += 1) {
    CHECK(gc.params.weights[i].cls == kCls[i], "the served weights are no longer nam, fdm, execution in that order");
    CHECK(gc.params.weights[i].ppm == kPpm[i], "the served weights are no longer 830000 / 120000 / 50000 ppm");
  }

  // timing.tOffset, both tiers
  JsonArrayConst t = cfg["timing"]["tOffset"].as<JsonArrayConst>();
  CHECK(gc.params.n_tiers == t.size(), "the tier count differs from the JSON");
  CHECK(gc.params.n_tiers == 2u, "the served config no longer has two tiers");
  for (size_t i = 0; i < t.size() && i < gc.params.n_tiers; i += 1) {
    CHECK((int)gc.params.tiers[i].tier == TierOf(t[i]["tier"].as<const char*>()), "a tier's name differs from the JSON");
    CHECK(gc.params.tiers[i].ppm == t[i]["ppm"].as<uint32_t>(), "a tier's ppm differs from the JSON");
    CHECK(gc.params.tiers[i].min_s == t[i]["minS"].as<uint32_t>(), "a tier's minS differs from the JSON");
    CHECK(gc.params.tiers[i].max_s == t[i]["maxS"].as<uint32_t>(), "a tier's maxS differs from the JSON");
  }
  struct Want { game::Tier tier; uint32_t ppm, min_s, max_s; };
  static const Want kTier[2] = {{game::Tier::Normal, 900000u, 300u, 900u}, {game::Tier::Snap, 100000u, 90u, 150u}};
  for (size_t i = 0; i < 2 && i < gc.params.n_tiers; i += 1) {
    CHECK(gc.params.tiers[i].tier == kTier[i].tier, "the served tiers are no longer normal, snap in that order");
    CHECK(gc.params.tiers[i].ppm == kTier[i].ppm, "the served tier ppm is no longer 900000 / 100000");
    CHECK(gc.params.tiers[i].min_s == kTier[i].min_s, "the served tier minS is no longer 300 / 90");
    CHECK(gc.params.tiers[i].max_s == kTier[i].max_s, "the served tier maxS is no longer 900 / 150");
  }

  // the timing scalars, each against the JSON and against the served value
  JsonObjectConst tm = cfg["timing"].as<JsonObjectConst>();
  CHECK(gc.ackCutoffS == tm["ackCutoffS"].as<uint32_t>(), "ackCutoffS differs from the JSON");
  CHECK(gc.ackCutoffS == 60u, "the served ackCutoffS is no longer 60");
  CHECK(gc.autoDecodeS == tm["autoDecodeS"].as<uint32_t>(), "autoDecodeS differs from the JSON");
  CHECK(gc.autoDecodeS == 300u, "the served autoDecodeS is no longer 300");
  CHECK(gc.maxClockSyncAgeS == tm["maxClockSyncAgeS"].as<uint32_t>(), "maxClockSyncAgeS differs from the JSON");
  CHECK(gc.maxClockSyncAgeS == 3600u, "the served maxClockSyncAgeS is no longer 3600");

  // seconds on the wire, microseconds in the device
  CHECK(gc.windowUs == Micros(tm["executionWindowS"].as<double>()), "windowUs differs from the JSON's executionWindowS");
  CHECK(gc.windowUs == 2000000u, "the served execution window is no longer 2 s");
  CHECK(gc.bucketUs == Micros(cfg["scoring"]["bucketS"].as<double>()), "bucketUs differs from the JSON's bucketS");
  CHECK(gc.bucketUs == 200000u, "the served bucket is no longer 0.2 s");
}

/// T2. The version-1 block -- float `weight`, no `ppm` -- is refused.
static void PrePpmConfigIsRefused(JsonObjectConst cfg) {
  CASE("the version-1 config (float weights, no ppm) is refused");
  // CONTROL: the input really is the v1 shape. Without this, an empty or
  // mangled file would be refused too, and this row would pass on nothing.
  CHECK(cfg["version"].as<int>() == 1, "CONTROL: the input is not the version-1 config");
  JsonArrayConst w = cfg["decode"]["weights"].as<JsonArrayConst>();
  bool shape = w.size() == 3;
  for (JsonObjectConst o : w) shape = shape && o["weight"].is<float>() && o["ppm"].isNull();
  CHECK(shape, "CONTROL: the input's weights are not three float `weight`s without `ppm`");

  eam::GameConfig gc;
  CHECK(!eam::ParseGameConfig(cfg, gc), "the pre-ppm config was ACCEPTED");
  CHECK(!gc.valid, "the pre-ppm config is marked valid");
}

int main(int argc, char** argv) {
  std::printf("GameConfig host tests\n");
  if (argc < 4 || argv[3][0] == '\0') {
    std::printf("  RIG: usage: test_game_config <game-config.json> <game-config-v1.config.json> <ArduinoJson pin>\n");
    return 2;
  }
  // Version parity, as a check rather than a comment: this is the firmware's
  // parser only if it is the firmware's ArduinoJson.
  std::printf("  ArduinoJson %s (platformio.ini pins %s)\n", ARDUINOJSON_VERSION, argv[3]);
  if (std::strcmp(ARDUINOJSON_VERSION, argv[3]) != 0) {
    std::printf("  RIG: the ArduinoJson under .pio/libdeps is not the version platformio.ini pins\n");
    return 2;
  }

  JsonDocument v2;
  JsonDocument v1;
  if (!Load(argv[1], v2) || !Load(argv[2], v1)) return 2;

  ServedConfigParses(v2["config"].as<JsonObjectConst>());
  PrePpmConfigIsRefused(v1["config"].as<JsonObjectConst>());

  std::printf("\n%d checks, %d failures\n", g_checks, g_failures);
  return g_failures ? 1 : 0;
}
