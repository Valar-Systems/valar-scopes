// Host tests for device/server AGREEMENT at the wire: the execution window and
// the commit body, graded against the vectors the server runs too.
//
// ===========================================================================
// ONE FIXTURE, TWO REPOSITORIES, THE SAME CASES.
//
// test/fixtures/derivation_fixture.h is generated by valar-eam-feed's
// scripts/emit-derivation-fixture.ts. Its JSON twin (test/fixtures/
// derivation.json there) is what the server's votes tests read. So every case
// below is also run, on the other side, against executeVote and POST /votes.
//
// TWO KINDS OF CASE, WITH DIFFERENT AUTHORITIES (say which before reading a
// failure):
//
//   kWindowCases  the 2026-10-11 ruling, "ResolveTurn -> T ± 1 s". The verdicts
//                 are written down from the ruling in the emitter, not produced
//                 by either implementation, and both are graded against them.
//                 A failure here is the DEVICE disagreeing with the ruling.
//   kCases        the server's own deriveMessage() output. A failure here is a
//                 commit body the server would refuse with derivation_mismatch:
//                 a device that cannot vote (enrollment-open checklist item 5).
//
// test_derive.cpp grades the derivation itself, field by field. This file
// grades what leaves the device: the body built from it.
// ===========================================================================

#include "../../src/game/Derive.h"
#include "../../src/game/DrillMachine.h"
#include "../../src/game/GameProtocol.h"

#include "derivation_fixture.h"  // -I test/fixtures, and only for the test binaries

#include <cstdio>
#include <cstring>

using namespace game;

static int g_failures = 0;
static int g_checks = 0;
static const char* g_case = "";

#define CHECK(cond, msg)                                                        \
  do {                                                                          \
    g_checks += 1;                                                              \
    if (!(cond)) {                                                              \
      g_failures += 1;                                                          \
      std::printf("  FAIL %s\n       %s\n       at %s:%d\n", g_case, msg,       \
                  __FILE__, __LINE__);                                          \
    }                                                                           \
  } while (0)

#define CASE(name)                                                              \
  g_case = name;                                                                \
  std::printf("  ---- %s\n", name);

static const uint64_t S = 1000000ull;

/// A drill armed against T under the served window width, every step a player act.
static DrillMachine Armed(uint64_t t) {
  Config cfg;
  cfg.window_us = derivation_fixture::kWindowWidthUs;
  DrillMachine m(cfg);
  m.SetT(t);
  EventArgs a;
  a.cls = MsgClass::Execution;
  m.Step(Event::MessageArrived, 0, a);
  m.Step(Event::PlayerOpen, 0);
  m.Step(Event::PrintFinished, 0);
  m.Step(Event::PlayerAck, 0);
  m.Step(Event::PlayerConfirmWarPlan, 0);
  m.Step(Event::PlayerEnable, 0);
  return m;
}

// ---------------------------------------------------------------------------
// The execution window
// ---------------------------------------------------------------------------

static void WindowVectorsCoverTheRuling() {
  CASE("window: the vectors cover both edges and one millisecond outside each");
  using derivation_fixture::kWindowCases;
  using derivation_fixture::kWindowCaseCount;
  const int64_t half = static_cast<int64_t>(derivation_fixture::kWindowWidthUs / 2);
  bool early_in = false, late_in = false, early_out = false, late_out = false;
  for (size_t i = 0; i < kWindowCaseCount; i++) {
    const derivation_fixture::WindowCase& c = kWindowCases[i];
    if (c.deviation_us == -half && c.counts) early_in = true;
    if (c.deviation_us == half && c.counts) late_in = true;
    if (c.deviation_us == -half - 1000 && !c.counts) early_out = true;
    if (c.deviation_us == half + 1000 && !c.counts) late_out = true;
    // Whole milliseconds only: below that the two sides' resolutions differ,
    // and which one decides is an open question no vector answers.
    CHECK(c.deviation_us % 1000 == 0, "a window vector is not a whole millisecond");
  }
  CHECK(early_in, "no case: the early edge, T - 1 s, counts");
  CHECK(late_in, "no case: the late edge, T + 1 s, counts");
  CHECK(early_out, "no case: 1 ms before the early edge does not count");
  CHECK(late_out, "no case: 1 ms after the late edge does not count");
  CHECK(kWindowCaseCount >= 7, "the fixture carries its window cases");

  CASE("window: the served width the vectors assume is this device's default");
  // A default that restates a published rule: the same 2 s twice, and here is
  // where the two copies are compared.
  CHECK(Config().window_us == derivation_fixture::kWindowWidthUs,
        "Config::window_us is not the width the shared vectors are written for");
}

/// Every vector, two ways in: a key turn judged on its own instant, and an arc
/// confirmed by a hold 300 ms later with frames ticking in between.
static void WindowVectorsOnTheDevice() {
  const uint64_t t = 100 * S;
  for (size_t i = 0; i < derivation_fixture::kWindowCaseCount; i++) {
    const derivation_fixture::WindowCase& c = derivation_fixture::kWindowCases[i];
    g_case = c.name;
    std::printf("  ---- window vector %s: %s\n", c.name, c.counts ? "counts" : "does not count");
    const uint64_t at = static_cast<uint64_t>(static_cast<int64_t>(t) + c.deviation_us);

    // What goes on the wire for this key: the server's Math.round, here.
    CHECK(DeviationMsForServer(c.deviation_us) == c.wire_ms,
          "DeviationMsForServer is not the server's Math.round for this vector");

    // 1. A key turn with no frame between it and the instant it was turned:
    //    ResolveTurn alone decides.
    {
      DrillMachine m = Armed(t);
      if (c.deviation_us >= 0) m.Step(Event::Tick, t);  // into Window at T
      m.Step(Event::PlayerKeyTurn, at);
      CHECK(m.Get().executed, "the key turn was not recorded");
      CHECK(m.Get().deviation_us == c.deviation_us, "the deviation is not the vector's");
      CHECK((m.Get().phase == Phase::Committed) == c.counts,
            c.counts ? "a key the ruling counts did not commit" : "a key the ruling refuses committed");
      if (!c.counts) {
        CHECK(std::strstr(m.Get().note, c.deviation_us < 0 ? "before the window" : "after the window")
                  != nullptr,
              "the refusal does not say which side of the window it missed");
      }
    }

    // 2. The arc (the SCORED instant) at the vector, the hold confirming it
    //    300 ms later, a frame between. The pending arc holds the window open
    //    for its hold, so the verdict is still the arc's.
    {
      DrillMachine m = Armed(t);
      if (c.deviation_us >= 0) m.Step(Event::Tick, t);
      m.Step(Event::PlayerKeyArc, at);
      m.Step(Event::Tick, at + 150000);
      m.Step(Event::PlayerKeyTurn, at + 300000);
      CHECK(m.Get().deviation_us == c.deviation_us, "scored at the confirm, not the arc");
      CHECK((m.Get().phase == Phase::Committed) == c.counts,
            c.counts ? "an arc the ruling counts did not commit" : "an arc the ruling refuses committed");
    }

    // 3. The execute body carries the vector's wire value, whichever way it went:
    //    the server records a failed execution's timing too.
    {
      char body[64];
      char want[64];
      std::snprintf(want, sizeof(want), "{\"deviation_ms\":%lld,\"enable_ok\":true}",
                    static_cast<long long>(c.wire_ms));
      CHECK(BuildExecuteBody(c.deviation_us, true, body, sizeof(body)) > 0, "no execute body");
      CHECK(std::strcmp(body, want) == 0, "the execute body is not the vector's wire value");
    }
  }
}

// ---------------------------------------------------------------------------
// The commit body: same inputs -> same class and T, at the wire
// ---------------------------------------------------------------------------

static DeriveParams FixtureParams() {
  DeriveParams p;
  p.epoch = derivation_fixture::kEpoch;
  for (const auto& w : derivation_fixture::kWeights) {
    p.weights[p.n_weights++] = {static_cast<MsgClass>(static_cast<uint8_t>(w.cls)), w.ppm};
  }
  for (const auto& tr : derivation_fixture::kTiers) {
    p.tiers[p.n_tiers++] = {static_cast<Tier>(static_cast<uint8_t>(tr.tier)), tr.ppm, tr.min_s, tr.max_s};
  }
  return p;
}

static bool HasNonAscii(const char* s) {
  for (; *s; s += 1) {
    if (static_cast<unsigned char>(*s) >= 0x80) return true;
  }
  return false;
}

/// For every fixture case: derive on the device, build the POST /votes body the
/// device would send, and compare it with the body assembled from the SERVER's
/// answer (its class name and its rendering of T). The server's suite commits
/// the same cases with the same class and T and gets 200 or
/// not_execution_traffic, never derivation_mismatch (game-derivation.test.ts).
static void CommitBodiesAgree() {
  CASE("commit: every fixture case's body carries the server's class and T");
  const DeriveParams p = FixtureParams();
  size_t built = 0;
  size_t execs = 0;
  for (size_t i = 0; i < derivation_fixture::kCaseCount; i++) {
    const derivation_fixture::Case& c = derivation_fixture::kCases[i];
    g_case = c.name;
    const Derivation d = Derive(c.msg_id, std::strlen(c.msg_id), c.heard_at, p);
    CHECK(d.status == DeriveStatus::Ok, "status Ok");
    char body[256];
    const size_t n = BuildCommitBody(c.msg_id, d.cls, p.epoch, d.t_at_ms, body, sizeof(body));

    if (HasNonAscii(c.msg_id)) {
      // The device never builds a body for an id outside [A-Za-z0-9-_.:]
      // (GameProtocol's IdSafe); the feed's ids are eam-<8 hex>. This case
      // exists to pin the HASH's input bytes, which test_derive.cpp grades.
      CHECK(n == 0, "a body was built for a non-ASCII msg_id");
      continue;
    }

    char want[256];
    if (c.t_at_ms >= 0) {
      std::snprintf(want, sizeof(want), "{\"msg_id\":\"%s\",\"class\":\"%s\",\"config_epoch\":%u,\"t_at\":\"%s\"}",
                    c.msg_id, c.class_wire, static_cast<unsigned>(derivation_fixture::kEpoch), c.t_at);
      execs += 1;
    } else {
      std::snprintf(want, sizeof(want), "{\"msg_id\":\"%s\",\"class\":\"%s\",\"config_epoch\":%u,\"t_at\":null}",
                    c.msg_id, c.class_wire, static_cast<unsigned>(derivation_fixture::kEpoch));
    }
    CHECK(n > 0, "no commit body was built");
    CHECK(std::strcmp(body, want) == 0, "the commit body's class or T is not the server's");
    if (std::strcmp(body, want) != 0) std::printf("       got  %s\n       want %s\n", body, want);
    built += 1;
  }
  g_case = "commit: coverage";
  CHECK(built + 1 >= derivation_fixture::kCaseCount, "fewer bodies built than ASCII cases");
  CHECK(execs >= 8, "the execution cases did not reach the body");
}

int main() {
  std::printf("Device/server agreement at the wire (window + commit body)\n");
  WindowVectorsCoverTheRuling();
  WindowVectorsOnTheDevice();
  CommitBodiesAgree();
  std::printf("  %d checks, %d failed\n", g_checks, g_failures);
  if (g_checks < 60) {
    std::printf("FAIL: only %d checks ran; the suite did not execute\n", g_checks);
    return 2;
  }
  return g_failures == 0 ? 0 : 1;
}
