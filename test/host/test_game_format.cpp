// Host tests for GameFormat — the device/server agreement test.
//
// ===========================================================================
// EVERY EXPECTED STRING IN HERE CAME FROM THE SERVER.
//
// test/fixtures/game_config_fixture.h is generated by valar-eam-feed's
// scripts/emit-device-fixture.ts, which fetches the deployed /config over the
// wire and then calls the server's own `formatSortieDeviation` for each row.
// Nothing below was typed by someone reading the server's source.
//
// That distinction is the whole test. A suite that asserted transcribed strings
// would agree with itself forever and would say nothing about the contract —
// the failure recorded as ledger 36, a test grading a private replica of the
// rule.
//
// THE FIXTURE IS A SNAPSHOT AND THIS SUITE IS OFFLINE. It does not fetch. The
// live half is a separate scheduled job (scripts/check-game-config-drift.mjs,
// and the generator's own --check); a network call inside a unit suite becomes
// a retry, then a skip, then nothing.
// ===========================================================================

#include "../../src/game/GameFormat.h"

#include "game_config_fixture.h"  // -I test/fixtures, and only for this binary

#include <cstdio>
#include <cstring>

using game::BucketDecimals;
using game::DeviationSense;
using game::FormatDeviation;
using game::Sense;

static int g_failures = 0;
static int g_checks = 0;
static const char* g_case = "";

#define CHECK(cond, msg)                                                        \
  do {                                                                          \
    g_checks += 1;                                                              \
    if (!(cond)) {                                                              \
      g_failures += 1;                                                          \
      std::printf("  FAIL %s\n       %s\n       at %s:%d\n", g_case, msg,       \
                  __FILE__, __LINE__);                                          \
    }                                                                           \
  } while (0)

#define CASE(name)                                                              \
  g_case = name;                                                                \
  std::printf("  ---- %s\n", name);

// ---------------------------------------------------------------------------

/// THE AGREEMENT TEST. Every row, every bucket, character for character.
static void AgreesWithTheServer() {
  CASE("device and server format the same deviation identically");
  char buf[game::kDeviationTextMax];
  size_t rows = 0;
  for (size_t t = 0; t < fixture::kTableCount; t += 1) {
    const fixture::Table& tab = fixture::kTables[t];

    // The decimals derivation, against the server's answer for this bucket.
    // Two different derivations -- String(bucketS) there, integer arithmetic
    // here -- so this is the check that they land in the same place.
    g_checks += 1;
    if (BucketDecimals(tab.bucket_us) != tab.decimals) {
      g_failures += 1;
      std::printf("  FAIL %s\n       bucket %u us: device says %u decimals, server says %u\n",
                  g_case, (unsigned)tab.bucket_us, (unsigned)BucketDecimals(tab.bucket_us),
                  (unsigned)tab.decimals);
    }

    for (size_t i = 0; i < tab.n; i += 1) {
      const fixture::Case& c = tab.cases[i];
      const bool ok = FormatDeviation(c.deviation_ms * 1000, tab.bucket_us, buf, sizeof(buf));
      g_checks += 1;
      rows += 1;
      if (!ok || std::strcmp(buf, c.expected) != 0) {
        g_failures += 1;
        std::printf("  FAIL %s\n       bucket %u us, deviation %lld ms:\n"
                    "       device \"%s\"   server \"%s\"\n",
                    g_case, (unsigned)tab.bucket_us, (long long)c.deviation_ms,
                    ok ? buf : "(refused)", c.expected);
      }
    }
  }
  // A fixture that silently emptied would make every assertion above vacuous,
  // and the suite would report a clean pass having compared nothing. This is
  // the same requirement as the drill suite's floor on its own check count.
  CHECK(rows >= 100, "the fixture is too small to have been the real one");
  CHECK(fixture::kTableCount >= 2, "only one bucket in the fixture: the decimals derivation is untested");
}

/// The live contract, named explicitly so a change to it is visible in a diff
/// rather than only in a regenerated table.
static void TheLiveBucket() {
  CASE("the live served constants are what the device was built against");
  CHECK(fixture::kBucketUs == 200000u, "the served bucket is no longer 0.2 s");
  CHECK(fixture::kClockFloorMs == 199u, "the served clock floor is no longer 199 ms");
  CHECK(fixture::kExecutionWindowUs == 2000000u, "the served execution window is no longer 2 s");

  bool live_found = false;
  for (size_t t = 0; t < fixture::kTableCount; t += 1) {
    if (fixture::kTables[t].live) {
      live_found = true;
      CHECK(fixture::kTables[t].bucket_us == fixture::kBucketUs,
            "the table marked live does not use the live bucket");
    }
  }
  CHECK(live_found, "no table in the fixture is marked live");
}

/// An unserved bucket is UNKNOWN, and unknown is not zero and not a guess.
static void NoBucketMeansNoNumber() {
  CASE("with no served bucket the device refuses rather than inventing one");
  char buf[game::kDeviationTextMax];
  std::strcpy(buf, "STALE");
  CHECK(!FormatDeviation(340000, 0, buf, sizeof(buf)), "formatted a figure with no bucket served");
  CHECK(buf[0] == '\0', "left the caller's buffer holding something printable");

  // And the control: the SAME call with a bucket must succeed, or the check
  // above would pass against a function that never formats anything.
  CHECK(FormatDeviation(340000, fixture::kBucketUs, buf, sizeof(buf)), "refused a well-formed call");
  CHECK(std::strcmp(buf, "0.4") == 0, "0.34 s did not round up into the 0.4 bucket");
}

/// The sign is carried beside the figure, never inside it.
static void SignIsSeparateFromTheFigure() {
  CASE("early and late produce the same figure and a different sense");
  char early[game::kDeviationTextMax];
  char late[game::kDeviationTextMax];
  CHECK(FormatDeviation(-300000, fixture::kBucketUs, early, sizeof(early)), "early refused");
  CHECK(FormatDeviation(300000, fixture::kBucketUs, late, sizeof(late)), "late refused");
  CHECK(std::strcmp(early, late) == 0, "the magnitude differs by direction; the server renders one number");
  CHECK(DeviationSense(-300000) == Sense::Early, "negative is not early");
  CHECK(DeviationSense(300000) == Sense::Late, "positive is not late");
  CHECK(DeviationSense(0) == Sense::Exact, "zero is not exact");

  // No sign character in the output. The leaderboard prints a magnitude, so a
  // '+' here would be a disagreement that looks like a formatting preference.
  CHECK(std::strchr(late, '+') == NULL, "the figure carries a sign");
  CHECK(std::strchr(early, '-') == NULL, "the figure carries a sign");
}

/// Buffer and range behaviour, since this writes into a caller's array.
static void RefusesRatherThanTruncates() {
  CASE("a short buffer is refused, not half-filled");
  char small[3];
  std::strcpy(small, "xx");
  CHECK(!FormatDeviation(12340000, fixture::kBucketUs, small, sizeof(small)),
        "wrote a truncated figure into a buffer too small for it");
  CHECK(small[0] == '\0', "left a truncated figure behind");

  char buf[game::kDeviationTextMax];
  CHECK(!FormatDeviation(0, 200000, NULL, 8), "did not refuse a null buffer");
  CHECK(!FormatDeviation(0, 200000, buf, 0), "did not refuse a zero-length buffer");

  // INT64_MIN has no positive counterpart; taking its magnitude naively is
  // undefined behaviour. It must produce something or refuse, never wrap.
  CHECK(FormatDeviation(INT64_MIN, 1000000u, buf, sizeof(buf)) || buf[0] == '\0',
        "INT64_MIN wrapped instead of formatting or refusing");
}

int main() {
  std::printf("GameFormat host tests\n");
  AgreesWithTheServer();
  TheLiveBucket();
  NoBucketMeansNoNumber();
  SignIsSeparateFromTheFigure();
  RefusesRatherThanTruncates();
  std::printf("\n%d checks, %d failures\n", g_checks, g_failures);
  if (g_checks < 100) {
    std::printf("FAIL: only %d checks ran; the suite did not execute\n", g_checks);
    return 2;
  }
  return g_failures == 0 ? 0 : 1;
}
